/*
 * Copyright (c) 2026 Analog Devices, Inc.
 *
 * SPDX-License-Identifier: MIT
 */

#include <dt-bindings/iio/sensor-channels.h>

/ {
	iio-context {
		iio-sensors {
			adxl345_pmod_acl {
				compatible = "iio,sensor";
				sensor-device = <&adxl345_pmod_acl>;
				sensor-channels = <IIO_SENSOR_CHAN_ACCEL_X
						   IIO_SENSOR_CHAN_ACCEL_Y
						   IIO_SENSOR_CHAN_ACCEL_Z>;
				buffer-name = "buffer0";
				io-name = "pmod-adxl345";
			};
		};
	};
};
