/*
 * Copyright (c) 2026 Analog Devices, Inc.
 *
 * SPDX-License-Identifier: MIT
 */

#include <dt-bindings/iio/sensor-channels.h>

/ {
	iio-context {
		#address-cells = <1>;
		#size-cells = <0>;

		iio-device@3 {
			compatible = "iio,sensor";
			reg = <3>;
			sensor-device = <&fxos8700>;
			sensor-channels = <IIO_SENSOR_CHAN_ACCEL_X
					   IIO_SENSOR_CHAN_ACCEL_Y
					   IIO_SENSOR_CHAN_ACCEL_Z
					   IIO_SENSOR_CHAN_MAGN_X
					   IIO_SENSOR_CHAN_MAGN_Y
					   IIO_SENSOR_CHAN_MAGN_Z
					   IIO_SENSOR_CHAN_DIE_TEMP>;
			buffer-name = "buffer0";
			io-name = "fxos8700";
		};
	};
};
