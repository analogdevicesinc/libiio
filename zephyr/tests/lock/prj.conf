## prj.conf
```kconfig
# Copyright (c) 2026 Analog Devices, Inc.
# SPDX-License-Identifier: MIT

CONFIG_ZTEST=y
CONFIG_ASSERT=y

CONFIG_POSIX_API=y
# libiio needs GNU-style static constructors, or the ARM link fails.
CONFIG_STATIC_INIT_GNU=y
CONFIG_LIBIIO=y
CONFIG_LIBIIO_MULTITHREADING=y

# Small pools keep the exhaustion tests cheap.
CONFIG_LIBIIO_THREAD_POOL_SIZE=4
CONFIG_LIBIIO_MUTEX_POOL_SIZE=6
CONFIG_LIBIIO_COND_POOL_SIZE=4
```

## src/lock.c
```c
/*
 * Copyright (c) 2026 Analog Devices, Inc.
 *
 * SPDX-License-Identifier: MIT
 *
 * Tests for the Zephyr implementation of the libiio lock and thread API.
 */

#include <iio/iio.h>
#include <iio/iio-lock.h>

#include <zephyr/kernel.h>
#include <zephyr/ztest.h>

#include <errno.h>

#ifndef CONFIG_LIBIIO_MULTITHREADING
#error "This suite tests the threaded lock backend; enable CONFIG_LIBIIO_MULTITHREADING"
#endif

#define ITERATIONS 2000

struct counter_ctx {
	struct iio_mutex *lock;
	volatile unsigned int count;
};

static int counter_thread(void *d)
{
	struct counter_ctx *ctx = d;
	unsigned int i;

	for (i = 0; i < ITERATIONS; i++) {
		iio_mutex_lock(ctx->lock);
		ctx->count = ctx->count + 1;
		iio_mutex_unlock(ctx->lock);
	}

	return 0;
}

ZTEST(libiio_lock, test_mutex_excludes)
{
	struct counter_ctx ctx = { .count = 0 };
	struct iio_thrd *a, *b;

	ctx.lock = iio_mutex_create();
	zassert_ok(iio_err(ctx.lock), "iio_mutex_create() failed");

	a = iio_thrd_create(counter_thread, &ctx, "counter-a");
	zassert_ok(iio_err(a), "iio_thrd_create() failed");
	b = iio_thrd_create(counter_thread, &ctx, "counter-b");
	zassert_ok(iio_err(b), "iio_thrd_create() failed");

	zassert_ok(iio_thrd_join_and_destroy(a));
	zassert_ok(iio_thrd_join_and_destroy(b));

	/* The no-op backend loses updates here. */
	zassert_equal(ctx.count, 2 * ITERATIONS, "lost updates: %u != %u", ctx.count,
		      2 * ITERATIONS);

	iio_mutex_destroy(ctx.lock);
}

ZTEST(libiio_lock, test_mutex_pool_exhaustion_and_reuse)
{
	struct iio_mutex *held[CONFIG_LIBIIO_MUTEX_POOL_SIZE];
	struct iio_mutex *extra;
	unsigned int n = 0, i;

	/* Count rather than assume the pool starts empty. */
	while (n < ARRAY_SIZE(held)) {
		struct iio_mutex *m = iio_mutex_create();

		if (iio_err(m))
			break;
		held[n++] = m;
	}

	zassert_true(n > 0, "could not allocate a single mutex");

	extra = iio_mutex_create();
	zassert_equal(iio_err(extra), -ENOMEM, "expected -ENOMEM once exhausted, got %d",
		      iio_err(extra));

	for (i = 0; i < n; i++)
		iio_mutex_destroy(held[i]);

	/* Slots must be reusable, not leaked. */
	extra = iio_mutex_create();
	zassert_ok(iio_err(extra), "slot was not released back to the pool");
	iio_mutex_destroy(extra);
}

struct cond_ctx {
	struct iio_mutex *lock;
	struct iio_cond *cond;
};

static int signal_thread(void *d)
{
	struct cond_ctx *ctx = d;

	/* The waiter holds the mutex until it waits, so this cannot be lost. */
	iio_mutex_lock(ctx->lock);
	iio_cond_signal(ctx->cond);
	iio_mutex_unlock(ctx->lock);

	return 0;
}

ZTEST(libiio_lock, test_cond_timeout_zero_does_not_block)
{
	struct cond_ctx ctx;
	int64_t start;
	int ret;

	ctx.lock = iio_mutex_create();
	zassert_ok(iio_err(ctx.lock));
	ctx.cond = iio_cond_create();
	zassert_ok(iio_err(ctx.cond));

	iio_mutex_lock(ctx.lock);
	start = k_uptime_get();
	ret = iio_cond_wait(ctx.cond, ctx.lock, 0);
	zassert_equal(ret, -ETIMEDOUT, "expected -ETIMEDOUT, got %d", ret);
	zassert_true(k_uptime_get() - start < 10, "a zero timeout must not block");
	iio_mutex_unlock(ctx.lock);

	iio_cond_destroy(ctx.cond);
	iio_mutex_destroy(ctx.lock);
}

ZTEST(libiio_lock, test_cond_timeout_expires)
{
	struct cond_ctx ctx;
	int64_t elapsed;
	int ret;

	ctx.lock = iio_mutex_create();
	zassert_ok(iio_err(ctx.lock));
	ctx.cond = iio_cond_create();
	zassert_ok(iio_err(ctx.cond));

	iio_mutex_lock(ctx.lock);
	elapsed = k_uptime_get();
	ret = iio_cond_wait(ctx.cond, ctx.lock, 100);
	elapsed = k_uptime_get() - elapsed;
	iio_mutex_unlock(ctx.lock);

	zassert_equal(ret, -ETIMEDOUT, "expected -ETIMEDOUT, got %d", ret);
	/* The no-op backend returns -ETIMEDOUT without waiting. */
	zassert_true(elapsed >= 100, "returned after only %lld ms", elapsed);

	iio_cond_destroy(ctx.cond);
	iio_mutex_destroy(ctx.lock);
}

ZTEST(libiio_lock, test_cond_signal_wakes_waiter)
{
	struct cond_ctx ctx;
	struct iio_thrd *thrd;
	int ret;

	ctx.lock = iio_mutex_create();
	zassert_ok(iio_err(ctx.lock));
	ctx.cond = iio_cond_create();
	zassert_ok(iio_err(ctx.cond));

	iio_mutex_lock(ctx.lock);

	thrd = iio_thrd_create(signal_thread, &ctx, "signaller");
	zassert_ok(iio_err(thrd));

	ret = iio_cond_wait(ctx.cond, ctx.lock, 5000);
	iio_mutex_unlock(ctx.lock);

	zassert_ok(ret, "wait was not woken by the signal, got %d", ret);
	zassert_ok(iio_thrd_join_and_destroy(thrd));

	iio_cond_destroy(ctx.cond);
	iio_mutex_destroy(ctx.lock);
}

ZTEST(libiio_lock, test_cond_pool_exhaustion_and_reuse)
{
	struct iio_cond *held[CONFIG_LIBIIO_COND_POOL_SIZE];
	struct iio_cond *extra;
	unsigned int n = 0, i;

	while (n < ARRAY_SIZE(held)) {
		struct iio_cond *c = iio_cond_create();

		if (iio_err(c))
			break;
		held[n++] = c;
	}

	zassert_true(n > 0, "could not allocate a single condvar");

	extra = iio_cond_create();
	zassert_equal(iio_err(extra), -ENOMEM, "expected -ENOMEM once exhausted, got %d",
		      iio_err(extra));

	for (i = 0; i < n; i++)
		iio_cond_destroy(held[i]);

	extra = iio_cond_create();
	zassert_ok(iio_err(extra), "slot was not released back to the pool");
	iio_cond_destroy(extra);
}

static int return_value_thread(void *d)
{
	return (int)(intptr_t)d;
}

ZTEST(libiio_lock, test_thrd_returns_value)
{
	struct iio_thrd *thrd;

	thrd = iio_thrd_create(return_value_thread, (void *)(intptr_t)42, "answer");
	zassert_ok(iio_err(thrd));
	zassert_equal(iio_thrd_join_and_destroy(thrd), 42);
}

static K_SEM_DEFINE(park_sem, 0, K_SEM_MAX_LIMIT);

static int parked_thread(void *d)
{
	ARG_UNUSED(d);

	k_sem_take(&park_sem, K_FOREVER);

	return 0;
}

ZTEST(libiio_lock, test_thrd_pool_exhaustion_and_reuse)
{
	struct iio_thrd *held[CONFIG_LIBIIO_THREAD_POOL_SIZE];
	struct iio_thrd *extra;
	unsigned int n = 0, i;

	k_sem_reset(&park_sem);

	while (n < ARRAY_SIZE(held)) {
		struct iio_thrd *t = iio_thrd_create(parked_thread, NULL, "parked");

		if (iio_err(t))
			break;
		held[n++] = t;
	}

	zassert_true(n > 0, "could not create a single thread");

	extra = iio_thrd_create(parked_thread, NULL, "overflow");
	zassert_equal(iio_err(extra), -ENOMEM, "expected -ENOMEM once exhausted, got %d",
		      iio_err(extra));

	/* Release the parked threads, then reclaim the slots. */
	for (i = 0; i < n; i++)
		k_sem_give(&park_sem);

	for (i = 0; i < n; i++)
		zassert_ok(iio_thrd_join_and_destroy(held[i]));

	extra = iio_thrd_create(return_value_thread, (void *)(intptr_t)7, "reused");
	zassert_ok(iio_err(extra), "slot was not released back to the pool");
	zassert_equal(iio_thrd_join_and_destroy(extra), 7);
}

ZTEST_SUITE(libiio_lock, NULL, NULL, NULL, NULL, NULL);
```

## src/responder.c
```c
/*
 * Copyright (c) 2026 Analog Devices, Inc.
 *
 * SPDX-License-Identifier: MIT
 *
 * Tests for how the iiod responder reports a pool-exhaustion failure. Zephyr is
 * the only platform where this is reachable: iio_cond_create() draws from a
 * fixed pool here, where the pthread backend allocates.
 */

#include <iio/iio.h>
#include <iio/iio-lock.h>

#include <zephyr/kernel.h>
#include <zephyr/ztest.h>

#include <errno.h>

#include "iiod-responder.h"

/* Parks the responder's reader thread so the responder stays live for the test:
 * a read that returns <= 0 sets thrd_stop, and iiod_enqueue_command() would then
 * refuse before it ever reaches the enqueue this test is about.
 */
static K_SEM_DEFINE(reader_parked, 0, 1);

static ssize_t loopback_read(void *d, const struct iiod_buf *buf, size_t nb)
{
	ARG_UNUSED(d);
	ARG_UNUSED(buf);
	ARG_UNUSED(nb);

	k_sem_take(&reader_parked, K_FOREVER);

	return 0;
}

static ssize_t loopback_write(void *d, const struct iiod_buf *buf, size_t nb)
{
	size_t i, total = 0;

	ARG_UNUSED(d);

	for (i = 0; i < nb; i++)
		total += buf[i].size;

	return (ssize_t)total;
}

static ssize_t loopback_discard(void *d, size_t bytes)
{
	ARG_UNUSED(d);

	return (ssize_t)bytes;
}

static int loopback_cmd(const struct iiod_command *cmd, struct iiod_command_data *data, void *d)
{
	ARG_UNUSED(cmd);
	ARG_UNUSED(data);
	ARG_UNUSED(d);

	return -EINVAL;
}

static const struct iiod_responder_ops loopback_ops = {
	.cmd = loopback_cmd,
	.read = loopback_read,
	.write = loopback_write,
	.discard = loopback_discard,
};

/* Take every remaining iio_cond slot, so the next iio_cond_create() fails. */
static unsigned int drain_cond_pool(struct iio_cond **held, unsigned int max)
{
	unsigned int n = 0;

	while (n < max) {
		struct iio_cond *cond = iio_cond_create();

		if (iio_err(cond))
			break;

		held[n++] = cond;
	}

	return n;
}

static void release_cond_pool(struct iio_cond **held, unsigned int n)
{
	while (n--)
		iio_cond_destroy(held[n]);
}

/*
 * A response whose write token cannot be created must be refused, not
 * remembered. iio_task_enqueue() reports the failure as an error pointer, and
 * every later reader of iiod_io::write_token tests it for NULL before
 * dereferencing it - so storing the error pointer turns a refused command into
 * a fault on the next round trip, and leaves the io permanently -EIO because the
 * "already enqueued" guard sees a non-NULL token.
 */
ZTEST(libiio_responder, test_enqueue_failure_is_reported_not_stored)
{
	struct iio_cond *held[CONFIG_LIBIIO_COND_POOL_SIZE];
	struct iiod_responder *responder;
	struct iiod_io *io;
	unsigned int n;
	int ret;

	k_sem_reset(&reader_parked);

	responder = iiod_responder_create(&loopback_ops, NULL);
	zassert_ok(iio_err(responder), "iiod_responder_create() failed (%d)",
		   iio_err(responder));

	io = iiod_responder_get_default_io(responder);
	zassert_not_null(io, "responder has no default io");

	n = drain_cond_pool(held, ARRAY_SIZE(held));
	zassert_true(n > 0, "cond pool already exhausted; the send would fail for the wrong reason");

	ret = iiod_io_send_response_async(io, 0, NULL, 0);
	zassert_equal(ret, -ENOMEM, "expected -ENOMEM with the cond pool drained, got %d", ret);

	/* Nothing was enqueued, so there is nothing to wait for. This faults if
	 * the error pointer was stored: iio_task_sync() dereferences it.
	 */
	zassert_ok(iiod_io_wait_for_command_done(io),
		   "wait_for_command_done() reported work that was never enqueued");

	/* Same dereference through the cancel path. */
	iiod_io_cancel(io);

	release_cond_pool(held, n);

	/* The refused send must not have wedged the io. A stored token makes this
	 * -EIO forever, which no client can distinguish from a transport error.
	 */
	ret = iiod_io_send_response_async(io, 0, NULL, 0);
	zassert_ok(ret, "send after a refused send failed (%d); the io kept a token", ret);

	zassert_ok(iiod_io_wait_for_command_done(io));

	k_sem_give(&reader_parked);
	iiod_responder_stop(responder);
	iiod_responder_wait_done(responder);
	iiod_responder_destroy(responder);
}

ZTEST_SUITE(libiio_responder, NULL, NULL, NULL, NULL, NULL);
```

## src/task.c
```c
/*
 * Copyright (c) 2026 Analog Devices, Inc.
 *
 * SPDX-License-Identifier: MIT
 *
 * Tests for the iio_task layer. Under NO_THREADS the task body runs inline on
 * the enqueuing thread and iio_task_start() drains the queue synchronously.
 */

#include <iio/iio.h>
#include <iio/iio-lock.h>

#include <zephyr/kernel.h>
#include <zephyr/ztest.h>

#include <errno.h>

#define BLOCK_MS 200

struct task_ctx {
	k_tid_t ran_on;
	struct k_sem started;
	struct k_sem release;
};

static int record_thread_fn(void *first, void *elm)
{
	struct task_ctx *ctx = first;

	ARG_UNUSED(elm);
	ctx->ran_on = k_current_get();

	return 1234;
}

ZTEST(libiio_task, test_task_runs_on_worker_thread)
{
	struct task_ctx ctx = { .ran_on = NULL };
	struct iio_task_token *token;
	struct iio_task *task;

	task = iio_task_create(record_thread_fn, &ctx, "record-task");
	zassert_ok(iio_err(task), "iio_task_create() failed");

	iio_task_start(task);

	token = iio_task_enqueue(task, NULL);
	zassert_ok(iio_err(token), "iio_task_enqueue() failed");

	zassert_equal(iio_task_sync(token, -1), 1234, "task return value not propagated");

	/* Must not have run inline on this thread, as NO_THREADS would. */
	zassert_not_null(ctx.ran_on, "task body never ran");
	zassert_not_equal(ctx.ran_on, k_current_get(),
			  "task body ran inline on the enqueuing thread");

	zassert_ok(iio_task_destroy(task));
}

static int blocking_fn(void *first, void *elm)
{
	struct task_ctx *ctx = first;

	ARG_UNUSED(elm);
	k_sem_give(&ctx->started);
	k_sem_take(&ctx->release, K_FOREVER);

	return 99;
}

static int delayed_release_thread(void *d)
{
	struct task_ctx *ctx = d;

	k_msleep(BLOCK_MS);
	k_sem_give(&ctx->release);

	return 0;
}

ZTEST(libiio_task, test_task_sync_timeout_cancels_pending)
{
	struct task_ctx ctx = { .ran_on = NULL };
	struct iio_task_token *token;
	struct iio_task *task;
	int64_t elapsed;
	int ret;

	task = iio_task_create(record_thread_fn, &ctx, "pending-task");
	zassert_ok(iio_err(task));

	/* Leave the task stopped so the token stays queued and can be cancelled. */
	token = iio_task_enqueue(task, NULL);
	zassert_ok(iio_err(token));

	elapsed = k_uptime_get();
	ret = iio_task_sync(token, 100);
	elapsed = k_uptime_get() - elapsed;

	zassert_equal(ret, -ETIMEDOUT, "expected -ETIMEDOUT, got %d", ret);
	zassert_true(elapsed >= 100, "returned after only %lld ms", elapsed);
	zassert_is_null(ctx.ran_on, "task body ran even though it was cancelled");

	zassert_ok(iio_task_destroy(task));
}

ZTEST(libiio_task, test_task_sync_waits_for_inflight_body)
{
	struct task_ctx ctx;
	struct iio_task_token *token;
	struct iio_task *task;
	struct iio_thrd *releaser;
	int64_t elapsed;
	int ret;

	k_sem_init(&ctx.started, 0, 1);
	k_sem_init(&ctx.release, 0, 1);

	task = iio_task_create(blocking_fn, &ctx, "blocking-task");
	zassert_ok(iio_err(task));
	iio_task_start(task);

	token = iio_task_enqueue(task, NULL);
	zassert_ok(iio_err(token));

	/* Make sure the body is genuinely in flight before syncing. */
	zassert_ok(k_sem_take(&ctx.started, K_MSEC(1000)), "task body never started");

	releaser = iio_thrd_create(delayed_release_thread, &ctx, "releaser");
	zassert_ok(iio_err(releaser));

	/*
	 * task.c drops the cancel once a token leaves the queue, so sync loops
	 * until the body completes. A short timeout is not an escape hatch.
	 */
	elapsed = k_uptime_get();
	ret = iio_task_sync(token, 10);
	elapsed = k_uptime_get() - elapsed;

	zassert_equal(ret, 99, "expected the body's return value, got %d", ret);
	zassert_true(elapsed >= BLOCK_MS, "sync did not wait for the body (%lld ms)", elapsed);

	zassert_ok(iio_thrd_join_and_destroy(releaser));
	zassert_ok(iio_task_destroy(task));
}

static atomic_t autoclear_ran;

static int autoclear_fn(void *first, void *elm)
{
	ARG_UNUSED(first);
	ARG_UNUSED(elm);
	atomic_set(&autoclear_ran, 1);

	return 0;
}

ZTEST(libiio_task, test_task_enqueue_autoclear)
{
	struct iio_task *task;
	unsigned int i;

	atomic_set(&autoclear_ran, 0);

	task = iio_task_create(autoclear_fn, NULL, "autoclear-task");
	zassert_ok(iio_err(task));
	iio_task_start(task);

	zassert_ok(iio_task_enqueue_autoclear(task, NULL));

	for (i = 0; i < 100 && !atomic_get(&autoclear_ran); i++)
		k_msleep(10);

	zassert_true(atomic_get(&autoclear_ran), "autoclear task body never ran");
	zassert_ok(iio_task_destroy(task));
}

ZTEST(libiio_task, test_task_stop_waits_for_inflight_body)
{
	struct task_ctx ctx;
	struct iio_task_token *token;
	struct iio_task *task;
	struct iio_thrd *releaser;
	int64_t elapsed;

	k_sem_init(&ctx.started, 0, 1);
	k_sem_init(&ctx.release, 0, 1);

	task = iio_task_create(blocking_fn, &ctx, "stop-task");
	zassert_ok(iio_err(task));
	iio_task_start(task);

	token = iio_task_enqueue(task, NULL);
	zassert_ok(iio_err(token));
	zassert_ok(k_sem_take(&ctx.started, K_MSEC(1000)), "task body never started");

	/*
	 * Nothing but iio_task_stop() may block inside the measured window, so
	 * the body is released from another thread and the clock starts before
	 * that thread exists. Sleeping here instead would satisfy the assertion
	 * on its own, whatever stop() did.
	 */
	elapsed = k_uptime_get();
	releaser = iio_thrd_create(delayed_release_thread, &ctx, "releaser");
	zassert_ok(iio_err(releaser));

	/* stop() waits for the worker's idle handshake, so it cannot return early. */
	iio_task_stop(task);
	elapsed = k_uptime_get() - elapsed;

	zassert_true(elapsed >= BLOCK_MS, "iio_task_stop() returned too early (%lld ms)", elapsed);

	/* The body ran to completion, so sync just reaps the token's pool slots. */
	zassert_equal(iio_task_sync(token, -1), 99, "task return value not propagated");

	zassert_ok(iio_thrd_join_and_destroy(releaser));
	zassert_ok(iio_task_destroy(task));
}

ZTEST_SUITE(libiio_task, NULL, NULL, NULL, NULL, NULL);
```
