## zephyr/tests/iiod/Kconfig
```kconfig
# Copyright (c) 2025-2026 Analog Devices, Inc.
# SPDX-License-Identifier: MIT

menu "iiod test"

config LIBIIO_IIOD_ADC_EMUL
	bool "Enable ADC emulator"
	help
	  Enable ADC emulator IIO device driver.

config LIBIIO_IIOD_SENSOR_EMUL
	bool "Enable sensor emulator"
	help
	  Enable sensor emulator IIO device driver.

config LIBIIO_IIOD_MULTI_SENSOR_EMUL
	bool "Enable multi-sensor emulator (two ADLTC2990 instances)"
	help
	  Enable two emulated ADLTC2990 sensor instances. Demonstrates that
	  the reg property and @N unit-address are required when multiple
	  nodes share the same compatible and name within an iio-sensors bus.

endmenu

source "Kconfig.zephyr"
```

## zephyr/tests/iiod_usb_class/testcase.yaml
```yaml
# Copyright (c) 2026 Analog Devices, Inc.
# SPDX-License-Identifier: MIT

tests:
  libiio.iiod.usb_class:
    tags:
      - libiio
      - iiod
      - usb
    platform_allow:
      - native_sim
    integration_platforms:
      - native_sim
```

## zephyr/tests/lock/testcase.yaml
```yaml
# Copyright (c) 2026 Analog Devices, Inc.
# SPDX-License-Identifier: MIT

tests:
  libiio.lock:
    tags:
      - libiio
      - lock
    platform_allow:
      - native_sim
      - apard32690/max32690/m4
    integration_platforms:
      - native_sim
```
