## CMakeLists.txt
```
# Copyright (c) 2026 Analog Devices, Inc.
# SPDX-License-Identifier: MIT

cmake_minimum_required(VERSION 3.20.0)
find_package(Zephyr REQUIRED HINTS $ENV{ZEPHYR_BASE})
project(libiio_accel)

target_sources(app PRIVATE src/main.c)
```

## prj.conf
```kconfig
# Copyright (c) 2026 Analog Devices, Inc.
# SPDX-License-Identifier: MIT

CONFIG_POSIX_API=y
CONFIG_LIBIIO=y
CONFIG_LIBIIO_STREAMING=y
CONFIG_SENSOR=y

# Keep logging off the USB link under test.
CONFIG_LOG=n
```

## boards/apard32690_max32690_m4.overlay
```dts
/*
 * Copyright (c) 2026 Analog Devices, Inc.
 *
 * SPDX-License-Identifier: MIT
 */

#include <mem.h>

&sram0 {
	reg = <0x20000000 DT_SIZE_M(1)>;
};

/delete-node/ &sram1;
/delete-node/ &sram2;
/delete-node/ &sram3;
/delete-node/ &sram4;
/delete-node/ &sram5;
/delete-node/ &sram6;
/delete-node/ &sram7;
```

## src/main.c
```c
/*
 * Copyright (c) 2026 Analog Devices, Inc.
 *
 * SPDX-License-Identifier: MIT
 */

/* IIOD's USB transport thread serves the host-side test. */
int main(void)
{
	return 0;
}
```
