## zephyr/Kconfig
```kconfig
# Copyright (c) 2025-2026 Analog Devices, Inc.
# SPDX-License-Identifier: MIT

menuconfig LIBIIO
	bool "libiio support"
	depends on POSIX_API
	select REQUIRES_FLOAT_PRINTF
	help
	  This option enables the libiio library.

if LIBIIO

module = LIBIIO
module-str = libiio
source "subsys/logging/Kconfig.template.log_config"

config LIBIIO_LOG_MSG_SIZE
	int "Maximum length of a single libiio log message (bytes)"
	default 128
	help
	  Each call to zephyr iio_prm_printf() formats the message into a stack-
	  allocated buffer of this size before handing it to the Zephyr
	  logging subsystem. Increase this value if libiio log messages are
	  being truncated.

config LIBIIO_STREAMING
	bool "libiio buffer streaming support"
	imply LIBIIO_MULTITHREADING
	select RTIO
	select RTIO_SYS_MEM_BLOCKS
	select RTIO_CONSUME_SEM if MULTITHREADING
	help
	  Enable buffer and block operations so clients can stream samples
	  from iio_device drivers. Block memory is reserved statically per
	  device, sized by the buffer-block-count and buffer-block-size-max
	  devicetree properties.

if LIBIIO_STREAMING

config LIBIIO_BUFFER_COUNT
	int "Maximum number of buffers open at once"
	default 2
	help
	  Buffers that can be open at once, across all devices and clients.
	  Each device allows one.

config LIBIIO_STREAM_CAPTURE_TIMEOUT_MS
	int "How long a dequeue waits for one capture, in milliseconds"
	default 30000
	range 1 3600000
	help
	  A capture that does not arrive in time fails the block with
	  -ETIMEDOUT. Must exceed the device's trigger period. Without
	  multithreading the wait polls every 5 ms, so the RTIO mempool must
	  hold 5 ms of captures.

config LIBIIO_MAX_SCAN_ELEMENTS
	int "Maximum scan elements per buffer"
	default 8
	help
	  Maximum number of channels a buffer can enable. A buffer whose
	  channel mask enables more is refused.

endif # LIBIIO_STREAMING

config LIBIIO_MULTITHREADING
	bool "libiio multi-threading support"
	help
	  Build libiio with real locking and threading, backed by Zephyr
	  k_mutex/k_condvar/k_thread instead of the no-op stubs in
	  lock-dummy.c, and with NO_THREADS=0. The two must change together:
	  the NO_THREADS paths in task.c run task bodies inline and release a
	  mutex they do not hold, which is only harmless with no-op mutexes.

	  Enable this when more than one iiod interpreter runs concurrently, as
	  the network and USB transports already do. The responder then gets
	  its own reader and writer threads and the locks on the shared buffer
	  and event stream lists take effect.

if LIBIIO_MULTITHREADING

config LIBIIO_THREAD_POOL_SIZE
	int "Maximum number of libiio internal threads"
	default 12 if LIBIIO_IIOD_NETWORK && LIBIIO_STREAMING
	default 9 if LIBIIO_STREAMING
	default 6 if LIBIIO_IIOD_NETWORK || LIBIIO_IIOD_USB
	default 3
	help
	  Slots in the static libiio thread pool. Each costs
	  LIBIIO_THREAD_STACK_SIZE bytes whether used or not.

	  Demand is 1 per concurrent interpreter - the responder's writer task,
	  since its read loop runs on the transport's own thread - plus 2 per
	  iiod buffer, plus 1 per buffer stream and per event stream.

	  An open buffer therefore costs three slots. Raise this with
	  LIBIIO_BUFFER_COUNT. Running out fails the client request with
	  -ENOMEM.

config LIBIIO_THREAD_STACK_SIZE
	int "Stack size for libiio internal threads"
	default 2048
	help
	  Stack size for each pool slot. Pool threads run task bodies, not
	  the iiod command dispatch, so they need less than the transport
	  thread.

config LIBIIO_THREAD_PRIORITY
	int "Priority for libiio internal threads"
	default 5
	help
	  Priority for every thread in the pool.

config LIBIIO_MUTEX_POOL_SIZE
	int "Maximum number of libiio mutexes"
	default 96 if LIBIIO_STREAMING
	default 48 if LIBIIO_IIOD_NETWORK || LIBIIO_IIOD_USB
	default 24
	help
	  Slots in the static iio_mutex pool. Three are held permanently by
	  tinyiiod. Each connection needs one for the responder, one for its
	  default io, one for the writer task, and one per in-flight task token
	  and command-created io. Each iiod buffer adds one for the buffer
	  entry, one for the stream, one per enqueue/dequeue task and one per
	  block token.

	  When streaming, a buffer costs roughly 3 + 3 * buffer-block-count.
	  Raise this with buffer-block-count or LIBIIO_BUFFER_COUNT.

config LIBIIO_COND_POOL_SIZE
	int "Maximum number of libiio condition variables"
	default 64 if LIBIIO_STREAMING
	default 32 if LIBIIO_IIOD_NETWORK || LIBIIO_IIOD_USB
	default 16
	help
	  Slots in the static iio_cond pool. Condition variables pair with
	  mutexes everywhere except the global tinyiiod locks and the
	  per-buffer and per-stream locks, so this can be smaller than
	  LIBIIO_MUTEX_POOL_SIZE.

	  Streaming demand also scales with buffer-block-count; raise this with
	  LIBIIO_MUTEX_POOL_SIZE.

endif # LIBIIO_MULTITHREADING

rsource "drivers/Kconfig"
rsource "iiod/Kconfig"

endif # LIBIIO
```

## zephyr/boards/shields/iio_eval_adxl362_ardz/Kconfig.defconfig
```kconfig
# Copyright (c) 2026 Analog Devices, Inc.
# SPDX-License-Identifier: MIT

if SHIELD_IIO_EVAL_ADXL362_ARDZ

configdefault ADXL362_STREAM
	default y

configdefault SPI_RTIO
	default y

endif # SHIELD_IIO_EVAL_ADXL362_ARDZ
```

## zephyr/boards/shields/iio_pmod_acl/Kconfig.defconfig
```kconfig
# Copyright (c) 2026 Analog Devices, Inc.
# SPDX-License-Identifier: MIT

if SHIELD_IIO_PMOD_ACL

configdefault ADXL345_STREAM
	default y

configdefault SPI_RTIO
	default y

endif # SHIELD_IIO_PMOD_ACL
```

## zephyr/dts/bindings/iio/iio,iio-device.yaml
```yaml
# Copyright (c) 2026 Analog Devices, Inc.
# SPDX-License-Identifier: MIT

include: base.yaml

properties:
  io-name:
    type: string
    description: |
      The device name for use within IIOD. If not set, the device's node will be used
      as a fallback.

  buffer-block-count:
    type: int
    default: 4
    description: |
      Number of buffer blocks this device can have allocated at once when
      CONFIG_LIBIIO_STREAMING is enabled. Clients such as iio_readdev need
      at least 4.

  buffer-block-size-max:
    type: int
    default: 1024
    description: |
      Largest block, in bytes, this device accepts when
      CONFIG_LIBIIO_STREAMING is enabled. Larger requests fail with -ENOMEM.

  rtio-block-count:
    type: int
    default: 8
    description: |
      Number of blocks in this device's RTIO mempool, which buffers
      captured frames between the driver and the backend, when
      CONFIG_LIBIIO_STREAMING is enabled.

  rtio-block-size:
    type: int
    default: 256
    description: |
      Size in bytes of one block in this device's RTIO mempool when
      CONFIG_LIBIIO_STREAMING is enabled. A capture takes as many
      contiguous blocks as it needs, so the whole pool must fit a FIFO
      drain.
```

## zephyr/dts/bindings/iio/iio,sensor.yaml
```yaml
# Copyright (c) 2025-2026 Analog Devices, Inc.
# SPDX-License-Identifier: MIT

include: iio,iio-device.yaml

description: IIO sensor

compatible: "iio,sensor"

properties:
  sensor-device:
    type: phandle
    required: true

  sensor-channels:
    type: array

  buffer-name:
    type: string

  attrs:
    type: array
    default: []
    description: |
      TODO

  attr-names:
    type: string-array
    default: []
    description: |
      TODO

  stream-triggers:
    type: array
    description: |
      Sensor triggers, from dt-bindings/iio/sensor-triggers.h, that
      complete one streaming read. If absent, the backend reads once per
      block. Each trigger is armed with SENSOR_STREAM_DATA_INCLUDE.

# Detailed sensor channel setup.
child-binding:
  properties:
    channel:
      type: int
      required: true

    attrs:
      type: array
      default: []
      description: |
        TODO

    attr-names:
      type: string-array
      default: []
      description: |
        TODO
```
