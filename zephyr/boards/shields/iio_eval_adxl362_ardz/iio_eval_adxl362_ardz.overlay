/*
 * Copyright (c) 2026 Analog Devices, Inc
 *
 * SPDX-License-Identifier: Apache-2.0
 */

#include <dt-bindings/iio/sensor-channels.h>
#include <dt-bindings/iio/sensor-triggers.h>

/ {
	iio-context {
		adxl362_eval_adxl362_ardz {
			compatible = "iio,sensor";
			io-name = "adxl362";
			sensor-device = <&adxl362_eval_adxl362_ardz>;
			sensor-channels = <
				IIO_SENSOR_CHAN_ACCEL_X
				IIO_SENSOR_CHAN_ACCEL_Y
				IIO_SENSOR_CHAN_ACCEL_Z
			>;
			stream-triggers = <IIO_SENSOR_TRIG_FIFO_WATERMARK>;
			buffer-name = "buffer0";
			buffer-block-size-max = <6144>;
		};
	};
};
