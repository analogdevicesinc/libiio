/*
 * Copyright (c) 2026 Analog Devices, Inc
 *
 * SPDX-License-Identifier: Apache-2.0
 */

#include <dt-bindings/iio/sensor-channels.h>

/ {
	iio-context {
		adafruit_ism330dhcx {
			compatible = "iio,sensor";
			io-name = "ism330dhcx";
			sensor-device = <&adafruit_ism330dhcx>;
			sensor-channels = <
				IIO_SENSOR_CHAN_ACCEL_X
				IIO_SENSOR_CHAN_ACCEL_Y
				IIO_SENSOR_CHAN_ACCEL_Z
				IIO_SENSOR_CHAN_GYRO_X
				IIO_SENSOR_CHAN_GYRO_Y
				IIO_SENSOR_CHAN_GYRO_Z
			>;
		};
	};
};
