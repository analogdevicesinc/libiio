/*
 * Copyright (c) 2026 Analog Devices, Inc
 * SPDX-License-Identifier: MIT
 */

#include <dt-bindings/iio/sensor-channels.h>

/ {
	iio-context {
		adxl367_mikroe_accel22_click {
			compatible = "iio,sensor";
			io-name = "adxl367";
			sensor-device = <&adxl367_mikroe_accel22_click>;
			sensor-channels = <
				IIO_SENSOR_CHAN_ACCEL_X
				IIO_SENSOR_CHAN_ACCEL_Y
				IIO_SENSOR_CHAN_ACCEL_Z
			>;
		};
	};
};
