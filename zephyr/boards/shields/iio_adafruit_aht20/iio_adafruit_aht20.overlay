/*
 * Copyright (c) 2026 Analog Devices, Inc
 *
 * SPDX-License-Identifier: Apache-2.0
 */

#include <dt-bindings/iio/sensor-channels.h>

/ {
	iio-context {
		adafruit_aht20 {
			compatible = "iio,sensor";
			io-name = "aht20";
			sensor-device = <&adafruit_aht20>;
			sensor-channels = <
				IIO_SENSOR_CHAN_AMBIENT_TEMP
				IIO_SENSOR_CHAN_HUMIDITY
			>;
		};
	};
};
