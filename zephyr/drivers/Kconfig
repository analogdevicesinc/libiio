## zephyr/drivers/Kconfig
```kconfig
# Copyright (c) 2025 Analog Devices, Inc.
# SPDX-License-Identifier: MIT

menu "Drivers"

rsource "adc/Kconfig"
rsource "iio_device/Kconfig"

endmenu
```

## zephyr/drivers/adc/Kconfig
```kconfig
# Copyright (c) 2025 Analog Devices, Inc.
# SPDX-License-Identifier: MIT

if ADC

menu "ADC"

config ADC_EMUL_GENERATOR
	bool "ADC emulator generator"
	default y
	depends on DT_HAS_IIO_ADC_EMUL_GENERATOR_ENABLED && ADC_EMUL

endmenu

endif # ADC
```

## zephyr/dts/bindings/adc/iio,adc-emul-generator.yaml
```yaml
# Copyright (c) 2025 Analog Devices, Inc.
# SPDX-License-Identifier: MIT

description: Zephyr ADC Emulator Generator

compatible: "iio,adc-emul-generator"

include: base.yaml

properties:
  io-channels:
    required: true
```

## zephyr/dts/bindings/iio/iio,adc.yaml
```yaml
# Copyright (c) 2025 Analog Devices, Inc.
# SPDX-License-Identifier: MIT

include: base.yaml

description: IIO ADC

compatible: "iio,adc"

properties:
  reg:
    required: true
  io-name:
    type: string
    description: |
      The device name for use within IIOD. If not set, the device's node will be used
      as a fallback.
```

## zephyr/dts/bindings/iio/iio,iio-device.yaml
```yaml
# Copyright (c) 2026 Analog Devices, Inc.
# SPDX-License-Identifier: MIT

include: base.yaml

properties:
  reg:
    required: true

  io-name:
    type: string
    description: |
      The device name for use within IIOD. If not set, the device's node will be used
      as a fallback.
```

## zephyr/dts/bindings/iio/iio,io-channels.yaml
```yaml
# Copyright (c) 2025 Analog Devices, Inc.
# SPDX-License-Identifier: MIT

include: iio,iio-device.yaml

description: IIO ADC/DAC io-channels

compatible: "iio,io-channels"

properties:
  io-channels:
    required: true
  io-channel-names:
    required: true
```

## zephyr/tests/iiod/boards/native_sim.conf
```kconfig
# Copyright (c) 2025 Analog Devices, Inc.
# SPDX-License-Identifier: MIT

CONFIG_LOG=y
CONFIG_LIBIIO_LOG_LEVEL_DBG=y
```
