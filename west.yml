## west.yml
```yaml
# Copyright (c) 2026 Analog Devices, Inc.
# SPDX-License-Identifier: MIT

manifest:
  remotes:
    - name: zephyrproject-rtos
      url-base: https://github.com/zephyrproject-rtos

  projects:
    - name: zephyr
      remote: zephyrproject-rtos
      revision: v4.5.0-rc3
      clone-depth: 1
      import:
        name-allowlist:
          - cmsis_6
          - hal_adi
          - hal_nordic
          - hal_nxp
          - hal_rpi_pico
          - hal_stm32
          - hal_st
          - net-tools
          - picolibc
```

## zephyr/Kconfig
```kconfig
# Copyright (c) 2025 Analog Devices, Inc.
# SPDX-License-Identifier: MIT

menuconfig LIBIIO
	bool "libiio support"
	depends on POSIX_API
	help
	  This option enables the libiio library.

if LIBIIO

module = LIBIIO
module-str = libiio
source "subsys/logging/Kconfig.template.log_config"

config LIBIIO_LOG_MSG_SIZE
	int "Maximum length of a single libiio log message (bytes)"
	default 128
	help
	  Each call to zephyr iio_prm_printf() formats the message into a stack-
	  allocated buffer of this size before handing it to the Zephyr
	  logging subsystem. Increase this value if libiio log messages are
	  being truncated.

config LIBIIO_MULTITHREADING
	bool "libiio multi-threading support"
	help
	  Build libiio with real locking and threading, backed by Zephyr
	  k_mutex/k_condvar/k_thread instead of the no-op stubs in
	  lock-dummy.c, and with NO_THREADS=0. The two must change together:
	  the NO_THREADS paths in task.c run task bodies inline and release a
	  mutex they do not hold, which is only harmless with no-op mutexes.

	  Enable this when more than one iiod interpreter runs concurrently, as
	  the network and USB transports already do. The responder then gets
	  its own reader and writer threads and the locks on the shared buffer
	  and event stream lists take effect.

if LIBIIO_MULTITHREADING

config LIBIIO_THREAD_POOL_SIZE
	int "Maximum number of libiio internal threads"
	default 12 if LIBIIO_IIOD_NETWORK
	default 6
	help
	  Slots in the static libiio thread pool. Each costs
	  LIBIIO_THREAD_STACK_SIZE bytes whether used or not.

	  Demand is 2 per connection (responder reader and writer), plus 2 per
	  iiod buffer and 1 per buffer or event stream.

config LIBIIO_THREAD_STACK_SIZE
	int "Stack size for libiio internal threads"
	default 4096
	help
	  Stack size for each pool slot. The deepest user is the responder
	  reader thread running the iiod command dispatch.

config LIBIIO_THREAD_PRIORITY
	int "Priority for libiio internal threads"
	default 5
	help
	  Priority for every thread in the pool.

config LIBIIO_MUTEX_POOL_SIZE
	int "Maximum number of libiio mutexes"
	default 48 if LIBIIO_IIOD_NETWORK
	default 24
	help
	  Slots in the static iio_mutex pool. Three are held permanently by
	  tinyiiod. Each connection needs one for the responder, one for its
	  default io, one for the writer task, and one per in-flight task token
	  and command-created io. Each iiod buffer adds one for the buffer
	  entry, one for the stream, one per enqueue/dequeue task and one per
	  block token.

config LIBIIO_COND_POOL_SIZE
	int "Maximum number of libiio condition variables"
	default 32 if LIBIIO_IIOD_NETWORK
	default 16
	help
	  Slots in the static iio_cond pool. Condition variables pair with
	  mutexes everywhere except the global tinyiiod locks and the
	  per-buffer and per-stream locks, so this can be smaller than
	  LIBIIO_MUTEX_POOL_SIZE.

endif # LIBIIO_MULTITHREADING

rsource "drivers/Kconfig"
rsource "iiod/Kconfig"

endif # LIBIIO
```

## zephyr/boards/shields/iio_adafruit_aht20/Kconfig.shield
```kconfig
# Copyright (c) 2026 Analog Devices, Inc
#
# SPDX-License-Identifier: Apache-2.0

config SHIELD_IIO_ADAFRUIT_AHT20
	def_bool $(shields_list_contains,iio_adafruit_aht20)
```

## zephyr/boards/shields/iio_adafruit_lis3dh/Kconfig.shield
```kconfig
# Copyright (c) 2026 Analog Devices, Inc
#
# SPDX-License-Identifier: Apache-2.0

config SHIELD_IIO_ADAFRUIT_LIS3DH
	def_bool $(shields_list_contains,iio_adafruit_lis3dh)
```

## zephyr/boards/shields/iio_adi_lsmspg/Kconfig.shield
```kconfig
# Copyright (c) 2026 Analog Devices, Inc
#
# SPDX-License-Identifier: Apache-2.0

config SHIELD_IIO_ADI_LSMSPG
	def_bool $(shields_list_contains,iio_adi_lsmspg)
```

## zephyr/boards/shields/iio_eval_adxl362_ardz/Kconfig.shield
```kconfig
# Copyright (c) 2026 Analog Devices, Inc
#
# SPDX-License-Identifier: Apache-2.0

config SHIELD_IIO_EVAL_ADXL362_ARDZ
	def_bool $(shields_list_contains,iio_eval_adxl362_ardz)
```

## zephyr/boards/shields/iio_mikroe_accel22_click/Kconfig.shield
```kconfig
# Copyright (c) 2026 Analog Devices, Inc
# SPDX-License-Identifier: MIT

config SHIELD_IIO_MIKROE_ACCEL22_CLICK
	def_bool $(shields_list_contains,iio_mikroe_accel22_click)
```

## zephyr/boards/shields/iio_mikroe_accel_click/Kconfig.shield
```kconfig
# Copyright (c) 2026 Analog Devices, Inc
# SPDX-License-Identifier: MIT

config SHIELD_IIO_MIKROE_ACCEL_CLICK
	def_bool $(shields_list_contains,iio_mikroe_accel_click)
```

## zephyr/boards/shields/iio_mikroe_adac_click/Kconfig.defconfig
```kconfig
# Copyright (c) 2026 Analog Devices, Inc
# SPDX-License-Identifier: MIT

if SHIELD_IIO_MIKROE_ADAC_CLICK

config ADC_AD559X_ACQUISITION_THREAD_STACK_SIZE
    default 768

endif # SHIELD_IIO_MIKROE_ADAC_CLICK
```

## zephyr/boards/shields/iio_mikroe_adac_click/Kconfig.shield
```kconfig
# Copyright (c) 2026 Analog Devices, Inc
# SPDX-License-Identifier: MIT

config SHIELD_IIO_MIKROE_ADAC_CLICK
	def_bool $(shields_list_contains,iio_mikroe_adac_click)
```

## zephyr/boards/shields/iio_mikroe_surface_temp_2_click/Kconfig.shield
```kconfig
# Copyright (c) 2026 Analog Devices, Inc
# SPDX-License-Identifier: Apache-2.0

config SHIELD_IIO_MIKROE_SURFACE_TEMP_2_CLICK
	def_bool $(shields_list_contains,iio_mikroe_surface_temp_2_click)
```

## zephyr/boards/shields/iio_pmod_acl/Kconfig.shield
```kconfig
# Copyright (c) 2026 Analog Devices, Inc
#
# SPDX-License-Identifier: Apache-2.0

config SHIELD_IIO_PMOD_ACL
	def_bool $(shields_list_contains,iio_pmod_acl)
```

## zephyr/boards/shields/iio_x_nucleo_iks4a1/Kconfig.shield
```kconfig
# Copyright (c) 2026 Analog Devices, Inc
#
# SPDX-License-Identifier: Apache-2.0

config SHIELD_IIO_X_NUCLEO_IKS4A1
	def_bool $(shields_list_contains,iio_x_nucleo_iks4a1)
```

## zephyr/drivers/gpio/Kconfig
```kconfig
# Copyright (c) 2026 Analog Devices, Inc.
# SPDX-License-Identifier: MIT

if GPIO

menu "GPIO"

config GPIO_EMUL_GENERATOR
	bool "GPIO emulator generator"
	default y
	depends on DT_HAS_IIO_GPIO_EMUL_GENERATOR_ENABLED && GPIO_EMUL

endmenu

endif # GPIO
```

## zephyr/drivers/iio_device/Kconfig
```kconfig
# Copyright (c) 2025 Analog Devices, Inc.
# SPDX-License-Identifier: MIT

menuconfig LIBIIO_IIO_DEVICE
	bool "IIO device drivers"
	default y
	help
	  Enable IIO device drivers

if LIBIIO_IIO_DEVICE

config LIBIIO_IIO_DEVICE_FP
	bool "Support full floating-point operation"
	select REQUIRES_FULL_LIBC
	help
	  Enable full floating point support, for inputs/outputs

config LIBIIO_IIO_DEVICE_IO_CHANNELS
	bool "ADC/DAC IO channels driver"
	default y
	depends on DT_HAS_IIO_IO_CHANNELS_ENABLED && (ADC || DAC)
	help
	  Enable the Zephyr ADC/DAC io channels iio device driver class.

config LIBIIO_IIO_DEVICE_IO_CHANNELS_INIT_PRIORITY
	int "ADC driver init priority"
	default KERNEL_INIT_PRIORITY_DEVICE
	depends on LIBIIO_IIO_DEVICE_IO_CHANNELS
	help
	  Initialization priority of the Zephyr ADC/DAC io-channels iio device driver class.

config LIBIIO_IIO_DEVICE_SENSOR
	bool "Sensor driver"
	default y
	depends on DT_HAS_IIO_SENSOR_ENABLED && SENSOR
	help
	  Enable the Zephyr Sensor iio device driver class.

config LIBIIO_IIO_DEVICE_SENSOR_INIT_PRIORITY
	int "Sensor driver init priority"
	default 90
	depends on LIBIIO_IIO_DEVICE_SENSOR
	help
	  Initialization priority of the Zephyr Sensor iio device driver class.
	  Has to be higher than the initialization priority of the sensor drivers.

config LIBIIO_IIO_DEVICE_ONE_BIT_ADC_DAC
	bool "One bit ADC DAC driver (GPIO lines as IIO channels)"
	default y
	depends on DT_HAS_IIO_ONE_BIT_ADC_DAC_ENABLED && GPIO
	help
	  Enable the one bit ADC DAC iio device driver, which exposes GPIOs
	  as IIO channels: input GPIOs as 1-bit input voltage channels and
	  output GPIOs as 1-bit output voltage channels, each with a raw
	  attribute holding the line level (0 or 1).

config LIBIIO_IIO_DEVICE_ONE_BIT_ADC_DAC_INIT_PRIORITY
	int "One bit ADC DAC driver init priority"
	default 90
	depends on LIBIIO_IIO_DEVICE_ONE_BIT_ADC_DAC
	help
	  Initialization priority of the one bit ADC DAC iio device driver.
	  Has to be higher than the initialization priority of the GPIO
	  controllers it uses, including GPIO expanders on I2C or SPI.

endif # LIBIIO_IIO_DEVICE
```

## zephyr/dts/bindings/gpio/iio,gpio-emul-generator.yaml
```yaml
# Copyright (c) 2026 Analog Devices, Inc.
# SPDX-License-Identifier: MIT

description: Zephyr GPIO Emulator Generator

compatible: "iio,gpio-emul-generator"

include: base.yaml

properties:
  gpios:
    type: phandle-array
    required: true
```

## zephyr/dts/bindings/iio/iio,fake-iio-device.yaml
```yaml
# Copyright (c) 2026 Analog Devices, Inc.
# SPDX-License-Identifier: MIT

description: Fake iio device, to be used as a mock or stub in tests.

compatible: "iio,fake-iio-device"

include: iio,iio-device.yaml

properties:
  fake-fail-init:
    type: boolean
    description: Fail initialization, so the device is not ready.
```

## zephyr/dts/bindings/iio/iio,one-bit-adc-dac.yaml
```yaml
# Copyright (c) 2026 Analog Devices, Inc.
# SPDX-License-Identifier: MIT

include: iio,iio-device.yaml

description: |
  One bit ADC DAC (GPIO mask)
  Exposes GPIO lines as 1-bit IIO voltage channels.

compatible: "iio,one-bit-adc-dac"

properties:
  "#address-cells":
    const: 1

  "#size-cells":
    const: 0

  in-gpios:
    type: phandle-array
    description: Input GPIO numbers

  out-gpios:
    type: phandle-array
    description: Output GPIO numbers

child-binding:
  description: |
    Represents the external channels which are connected to the ADDAC.
    Inputs are numbered first, followed by the outputs.

  properties:
    reg:
      type: int
      required: true
      description: The channel number.

    label:
      type: string
      description: Unique name to identify which channel this is.
```

## zephyr/dts/bindings/iio/iio,sensor.yaml
```yaml
# Copyright (c) 2025 Analog Devices, Inc.
# SPDX-License-Identifier: MIT

include: iio,iio-device.yaml

description: IIO sensor

compatible: "iio,sensor"

properties:
  sensor-device:
    type: phandle
    required: true

  sensor-channels:
    type: array

  buffer-name:
    type: string

  attrs:
    type: array
    default: []
    description: |
      TODO

  attr-names:
    type: string-array
    default: []
    description: |
      TODO

# Detailed sensor channel setup.
child-binding:
  properties:
    channel:
      type: int
      required: true

    attrs:
      type: array
      default: []
      description: |
        TODO

    attr-names:
      type: string-array
      default: []
      description: |
        TODO
```

## zephyr/dts/bindings/usb/adi,iio-usb.yaml
```yaml
# Copyright (c) 2025 Analog Devices, Inc.
# SPDX-License-Identifier: MIT

include: base.yaml

description: IIO USB device class

compatible: "adi,iio-usb"

on-bus: usb

properties:
  num-pipes:
    type: int
    default: 3
    min: 1
    description: |
      Number of USB bulk endpoint pairs (pipes). Pipe 0 is the IIOD
      command channel. Additional pipes are used for data streaming
      (one per concurrent buffer/stream). Each pipe requires one IN
      and one OUT bulk endpoint.

  rx-depth:
    type: int
    default: 2
    min: 2
    description: |
      Receive buffers each pipe may hold at once: one armed on the
      endpoint and one being read by the interpreter, so the endpoint
      does not go bare between packets. The class allocates
      num-pipes * rx-depth of them.

  tx-buf-size:
    type: int
    default: 512
    description: |
      Size in bytes of each chunk when transmitting over USB. Every
      chunk costs a transfer and a completion, so smaller values trade
      throughput for a smaller buffer pool. Must be a multiple of the
      largest bulk packet the build can use (512 on a high-speed
      capable build, 64 otherwise), so that a chunk ends on a packet
      boundary rather than a short packet that would end the host's
      read early.
```
